## sdkconfig.defaults
```kconfig
CONFIG_IDF_TARGET="esp32s3"

## USB MIDI (TinyUSB) ##
CONFIG_TINYUSB_MIDI_COUNT=1
# Route log output to UART0 so USB port can be used for MIDI
CONFIG_ESP_CONSOLE_UART_DEFAULT=y
# Disable USB-Serial/JTAG secondary console so it doesn't fight TinyUSB for GPIO 19/20
CONFIG_ESP_CONSOLE_SECONDARY_NONE=y
CONFIG_LV_COLOR_16_SWAP=y
CONFIG_LV_FONT_MONTSERRAT_12=y
CONFIG_LV_FONT_MONTSERRAT_16=y
CONFIG_LV_FONT_MONTSERRAT_20=y
CONFIG_LV_FONT_MONTSERRAT_48=y
CONFIG_LV_USE_DEMO_WIDGETS=y
CONFIG_LV_USE_DEMO_BENCHMARK=y
CONFIG_LV_USE_DEMO_STRESS=y
CONFIG_LV_USE_DEMO_MUSIC=y

## LVGL8 ##
CONFIG_LV_MEM_SIZE_KILOBYTES=48
```
